## wic/torizon-ab-x86.wks
```
# short-description: Torizon OS A/B (dual rootfs) + SWUpdate EFI disk image
# long-description:
#   GPT layout for a classic A/B update scheme (no OSTree):
#     p1 /boot  vfat  label=efi        - GRUB EFI + grub.cfg + grubenv (shared)
#     p2 /      ext4  label=otaroot_a  - rootfs slot A (factory), kernel in /boot
#     p3        ext4  label=otaroot_b  - rootfs slot B (empty at flash)
#     p4 /var   ext4  label=data       - shared persistent data
#
# IMPORTANT: each slot must be >= the size of the DECOMPRESSED rootfs ext4
# image that SWUpdate raw-writes (not the compressed .swu size). That ext4 is
# sized by IMAGE_OVERHEAD_FACTOR (~1.5x content), so ~1.6 GB of content becomes
# a ~2.4 GB image -> 4 GiB slots here for comfortable headroom. For production,
# reduce the image size instead
# (set a fixed IMAGE_ROOTFS_SIZE / IMAGE_OVERHEAD_FACTOR=1) to keep slots and the
# .swu small; that changes the .ext4 and requires re-uploading the .swu.
# Check the actual image size with:
#   ls -l tmp/deploy/images/<machine>/torizon-minimal-ab-<machine>.ext4
#
# The /var (data) partition must be big enough to hold the downloaded .swu
# (aktualizr stores it under /var/sota before applying) PLUS persistent data
# (and /var/lib/docker for the docker variant). The ~800 MB rootfs .swu needs
# well more than 1 GiB here, so /var is 4 GiB. Tune to your update size.

# --no-fstab-update: we ship a static /etc/fstab (base-files bbappend) so that
# .swu-delivered slots self-contain their mounts; without this wic would ALSO
# add /boot/efi and /var entries, causing duplicate-fstab warnings.
part /boot/efi --source bootimg-efi --sourceparams="loader=grub-efi" --ondisk sda --label efi --active --align 1024 --fixed-size 128 --no-fstab-update
part /     --source rootfs      --ondisk sda --fstype=ext4 --label otaroot_a --align 1024 --fixed-size 4096 --no-fstab-update
part       --ondisk sda --fstype=ext4 --label otaroot_b --align 1024 --fixed-size 4096
part /var  --ondisk sda --fstype=ext4 --label data       --align 1024 --fixed-size 4096 --no-fstab-update

bootloader --ptable gpt --timeout=3 --configfile="grub.cfg"
```
